## conf/layer.conf
```bitbake
# We have a conf and classes directory, add to BBPATH
BBPATH .= ":${LAYERDIR}"

# We have recipes-* directories, add to BBFILES
BBFILES += "${LAYERDIR}/recipes-*/*/*.bb \
            ${LAYERDIR}/recipes-*/*/*.bbappend \
            ${LAYERDIR}/images/*.bb"

BBFILE_COLLECTIONS += "bananapi"
BBFILE_PATTERN_bananapi = "^${LAYERDIR}/"
BBFILE_PRIORITY_bananapi = "6"
LAYERVERSION_bananapi = "1"
LAYERSERIES_COMPAT_bananapi="thud"
```
